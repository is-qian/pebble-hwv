## CMakeLists.txt
```
cmake_minimum_required(VERSION 3.13.1)
find_package(Zephyr REQUIRED HINTS $ENV{ZEPHYR_BASE})

project(app LANGUAGES C)

target_sources(
  app
  PRIVATE
    src/audio_data.c
    src/main.c
    src/ble.c
    src/buttons.c
    src/charger.c
    src/display.c
    src/flash.c
    src/haptic.c
    src/imu.c
    src/light.c
    src/mag.c
    src/mic.c
    src/press.c
    src/speaker.c
)
```

## Kconfig
```
menu "Zephyr"
source "Kconfig.zephyr"
endmenu

module = HWV
module-str = HWV
source "subsys/logging/Kconfig.template.log_config"
```

## sample.yaml
```
sample:
  description: Pebble HWV
  name: pebble-hwv
common:
  build_only: true
  integration_platforms:
    - asterix_evt1
tests:
  app.default: {}
```

## prj.conf
```kconfig
CONFIG_BT=y
CONFIG_BT_PERIPHERAL=y
CONFIG_BT_DEVICE_NAME="Pebble HWV"

CONFIG_CBPRINTF_FP_SUPPORT=y

CONFIG_INPUT=y
CONFIG_DISPLAY=y
CONFIG_SERIAL=y
CONFIG_HAPTIC=y
CONFIG_SENSOR=y
CONFIG_REGULATOR=y
CONFIG_FLASH=y
CONFIG_FLASH_JESD216_API=y
CONFIG_I2S=y
CONFIG_AUDIO=y
CONFIG_AUDIO_DMIC=y

CONFIG_BT_CTLR=y
CONFIG_BT_CTLR_TX_PWR_PLUS_4=y
CONFIG_BT_SHELL=y
CONFIG_BT_OBSERVER=y

CONFIG_SHELL=y
CONFIG_PM_DEVICE=y
CONFIG_PM_DEVICE_RUNTIME=y
CONFIG_HEAP_MEM_POOL_SIZE=2048

CONFIG_CONSOLE=y
CONFIG_UART_CONSOLE=y

CONFIG_NORDIC_QSPI_NOR_INIT_PRIORITY=90
```

## no-serial.conf
```kconfig
CONFIG_SERIAL=n

CONFIG_CONSOLE=n
CONFIG_UART_CONSOLE=n

CONFIG_SHELL_BACKEND_SERIAL=n
CONFIG_SHELL_BACKEND_DUMMY=y
```

## rtt.conf
```kconfig
CONFIG_USE_SEGGER_RTT=y
CONFIG_RTT_CONSOLE=y
CONFIG_SHELL_BACKEND_RTT=y
```

## src/main.c
```c
#include "speaker.h"
#include "buttons.h"
#include "charger.h"
#include "display.h"
#include "flash.h"
#include "haptic.h"
#include "light.h"
#include "imu.h"
#include "mag.h"
#include "mic.h"
#include "press.h"

#include <stdio.h>

#include <zephyr/shell/shell.h>
#include <zephyr/shell/shell_uart.h>

#include <app_version.h>
#include <zephyr/kernel.h>

#define STACK_SIZE 1024 
#define PRIORITY 7  

K_THREAD_STACK_DEFINE(test_stack_area, STACK_SIZE); 
struct k_thread test_thread_data;                 

SHELL_SUBCMD_SET_CREATE(hwv_cmds, (hwv));
SHELL_CMD_REGISTER(hwv, &hwv_cmds, "HWV commands", NULL);

void test_loop(void)
{
	const struct shell *shell = shell_backend_uart_get_ptr();
	bool last_buttons_flag = buttons_flag;
	while (1) {
		if(buttons_flag)
		{
			if(buttons_flag != last_buttons_flag)
			{
				shell_execute_cmd(NULL, "hwv display on");
				shell_execute_cmd(NULL, "hwv display vpattern");
				shell_execute_cmd(NULL, "hwv display brightness 100");
				shell_execute_cmd(NULL, "hwv haptic configure 50");
				shell_execute_cmd(NULL, "hwv ble on");
				printf("buttons_flag = %d\n", buttons_flag);
				last_buttons_flag = buttons_flag;
			}

			shell_execute_cmd(shell, "hwv speaker play");
			shell_execute_cmd(shell, "hwv imu get");
			shell_execute_cmd(shell, "hwv light get");
			shell_execute_cmd(shell, "hwv mag get");
			shell_execute_cmd(shell, "hwv press get");
		}
		else
		{
			if(buttons_flag != last_buttons_flag)
			{
				shell_execute_cmd(NULL, "hwv display off");
				shell_execute_cmd(NULL, "hwv display brightness 0");
				shell_execute_cmd(NULL, "hwv haptic configure 0");
				shell_execute_cmd(NULL, "hwv ble off");
				printf("buttons_flag = %d\n", buttons_flag);
				last_buttons_flag = buttons_flag;
			}
		}
		k_sleep(K_MSEC(1000));
	}
}

int main(void)
{
	int ret;

	printf("HWV v%s\n", APP_VERSION_STRING);

	ret = buttons_init();
	if (ret < 0) {
		printf("Failed to initialize buttons module (%d)\n", ret);
	}

	ret = charger_init();
	if (ret < 0) {
		printf("Failed to initialize charger module (%d)\n", ret);
	}

	ret = display_init();
	if (ret < 0) {
		printf("Failed to initialize display module (%d)\n", ret);
	}

	ret = flash_init();
	if (ret < 0) {
		printf("Failed to initialize flash module (%d)\n", ret);
	}

	ret = haptic_init();
	if (ret < 0) {
		printf("Failed to initialize haptic module (%d)\n", ret);
	}

	ret = light_init();
	if (ret < 0) {
		printf("Failed to initialize light sensor module (%d)\n", ret);
	}

	ret = imu_init();
	if (ret < 0) {
		printf("Failed to initialize IMU module (%d)\n", ret);
	}

	ret = mag_init();
	if (ret < 0) {
		printf("Failed to initialize magnetometer module (%d)\n", ret);
	}

	ret = mic_init();
	if (ret < 0) {
		printf("Failed to initialize microphone module (%d)\n", ret);
	}

	ret = press_init();
	if (ret < 0) {
		printf("Failed to initialize pressure sensor module (%d)\n", ret);
	}

	ret = speaker_init();
	if (ret < 0) {
		printf("Failed to initialize speaker module (%d)\n", ret);
	}

    k_thread_create(&test_thread_data, test_stack_area, STACK_SIZE,
		(k_thread_entry_t)test_loop, NULL, NULL, NULL,
		PRIORITY, 0, K_NO_WAIT);

    const struct shell *shell = shell_backend_uart_get_ptr();
	shell_execute_cmd(shell, "hwv buttons check");
	
	return 0;
}
```

## src/audio_data.h
```c
#include <stdint.h>

#define SAMPLE_FREQUENCY   44100
#define BYTES_PER_SAMPLE   sizeof(int16_t)
#define NUMBER_OF_CHANNELS 2

/* Such block length provides an echo with the delay of 100 ms. */
#define SAMPLES_PER_BLOCK ((SAMPLE_FREQUENCY / 10) * NUMBER_OF_CHANNELS)
#define BLOCK_SIZE        (BYTES_PER_SAMPLE * SAMPLES_PER_BLOCK)

extern int16_t audio_data[BLOCK_SIZE];
```

## src/ble.c
```c
#include <stdio.h>

#include <zephyr/bluetooth/bluetooth.h>
#include <zephyr/bluetooth/hci.h>
#include <zephyr/bluetooth/conn.h>
#include <zephyr/bluetooth/uuid.h>
#include <zephyr/bluetooth/gatt.h>
#include <zephyr/shell/shell.h>

#define BT_UUID_ONOFF_VAL BT_UUID_128_ENCODE(0x00001523, 0x1212, 0xefde, 0x1523, 0x785feabcd123)
#define BT_UUID_ONOFF     BT_UUID_DECLARE_128(BT_UUID_ONOFF_VAL)
#define BT_UUID_ONOFF_ACTION_VAL                                                                   \
	BT_UUID_128_ENCODE(0x00001525, 0x1212, 0xefde, 0x1523, 0x785feabcd123)
#define BT_UUID_ONOFF_ACTION BT_UUID_DECLARE_128(BT_UUID_ONOFF_ACTION_VAL)

static const struct bt_data ad[] = {
	BT_DATA_BYTES(BT_DATA_FLAGS, (BT_LE_AD_GENERAL | BT_LE_AD_NO_BREDR)),
	BT_DATA(BT_DATA_NAME_COMPLETE, CONFIG_BT_DEVICE_NAME, sizeof(CONFIG_BT_DEVICE_NAME) - 1),
};

static const struct bt_data sd[] = {
	BT_DATA_BYTES(BT_DATA_UUID128_ALL, BT_UUID_ONOFF_VAL),
};

static ssize_t write_onoff_val(struct bt_conn *conn, const struct bt_gatt_attr *attr,
			       const void *buf, uint16_t len, uint16_t offset, uint8_t flags)
{
	uint8_t val;

	if (len != 1U) {
		return BT_GATT_ERR(BT_ATT_ERR_INVALID_ATTRIBUTE_LEN);
	}

	if (offset != 0) {
		return BT_GATT_ERR(BT_ATT_ERR_INVALID_OFFSET);
	}

	val = *((uint8_t *)buf);

	if (val == 0x00U) {
		printf("Write: 0\n");
	} else if (val == 0x01U) {
		printf("Write: 1\n");
	} else {
		return BT_GATT_ERR(BT_ATT_ERR_VALUE_NOT_ALLOWED);
	}

	return len;
}

BT_GATT_SERVICE_DEFINE(lbs_svc, BT_GATT_PRIMARY_SERVICE(BT_UUID_ONOFF),
		       BT_GATT_CHARACTERISTIC(BT_UUID_ONOFF_ACTION, BT_GATT_CHRC_WRITE,
					      BT_GATT_PERM_WRITE, NULL, write_onoff_val, NULL), );

static void connected(struct bt_conn *conn, uint8_t err)
{
	if (err != 0U) {
		printf("Connection failed (%02x, %s)\n", err, bt_hci_err_to_str(err));
		return;
	}

	printf("Connected\n");
}

static void disconnected(struct bt_conn *conn, uint8_t reason)
{
	printf("Disconnected (%02x, %s)\n", reason, bt_hci_err_to_str(reason));
}

BT_CONN_CB_DEFINE(conn_callbacks) = {
	.connected = connected,
	.disconnected = disconnected,
};

static int cmd_ble_on(const struct shell *sh, size_t argc, char **argv)
{
	int err;

	ARG_UNUSED(argc);
	ARG_UNUSED(argv);

	err = bt_enable(NULL);
	if (err < 0) {
		shell_error(sh, "Bluetooth enable failed (err %d)", err);
		return err;
	}

	err = bt_le_adv_start(BT_LE_ADV_CONN_FAST_1, ad, ARRAY_SIZE(ad), sd, ARRAY_SIZE(sd));
	if (err < 0) {
		shell_error(sh, "Advertising failed to start (err %d)", err);
		return err;
	}

	shell_print(sh, "Bluetooth enabled");

	return 0;
}

static int cmd_ble_off(const struct shell *sh, size_t argc, char **argv)
{
	int err;

	ARG_UNUSED(argc);
	ARG_UNUSED(argv);

	err = bt_disable();
	if (err < 0) {
		shell_error(sh, "Bluetooth disable failed (%d)", err);
		return err;
	}

	shell_print(sh, "Bluetooth disabled");

	return 0;
}

SHELL_STATIC_SUBCMD_SET_CREATE(sub_ble_cmds, SHELL_CMD(on, NULL, "Turn on BLE", cmd_ble_on),
			       SHELL_CMD(off, NULL, "Turn off BLE", cmd_ble_off),
			       SHELL_SUBCMD_SET_END);

SHELL_SUBCMD_ADD((hwv), ble, &sub_ble_cmds, "BLE", NULL, 0, 0);
```

## src/buttons.c
```c
#include <errno.h>

#include <zephyr/input/input.h>
#include <zephyr/kernel.h>
#include <zephyr/pm/device_runtime.h>
#include <zephyr/shell/shell.h>
#include "buttons.h"

static const struct device *const buttons = DEVICE_DT_GET(DT_ALIAS(buttons));
K_MSGQ_DEFINE(input_q, sizeof(struct input_event), 10, 1);
static bool initialized;
bool buttons_flag = false;
static void buttons_input_cb(struct input_event *evt, void *user_data)
{
	ARG_UNUSED(user_data);

	(void)k_msgq_put(&input_q, evt, K_NO_WAIT);
}

INPUT_CALLBACK_DEFINE(buttons, buttons_input_cb, NULL);

static int cmd_buttons_check(const struct shell *sh, size_t argc, char **argv)
{
	int ret;

	ARG_UNUSED(argc);
	ARG_UNUSED(argv);

	if (!initialized) {
		shell_error(sh, "Buttons module not initialized");
		return -EPERM;
	}

	ret = pm_device_runtime_get(buttons);
	if (ret < 0) {
		shell_error(sh, "Failed to get device (%d)", ret);
		return 0;
	}

	k_msgq_purge(&input_q);

	while (1) {
		int ret;
		struct input_event evt;

		ret = k_msgq_get(&input_q, &evt, K_FOREVER);
		if (ret == -EAGAIN) {
			shell_error(sh, "No input received");
			return 0;
		}

		switch (evt.code) {
		case INPUT_KEY_BACK:
			if (evt.value == 1) {
				buttons_flag = true;
				shell_print(sh, "Back button pressed");
			} else {
				shell_print(sh, "Back button released");
			}
			break;
		case INPUT_KEY_UP:
			if (evt.value == 1) {
				buttons_flag = false;
				shell_print(sh, "Up button pressed");
			} else {
				shell_print(sh, "Up button released");
			}
			break;
		case INPUT_KEY_ENTER:
			if (evt.value == 1) {
				shell_print(sh, "Enter button pressed");
			} else {
				shell_print(sh, "Enter button released");
			}
			break;
		case INPUT_KEY_DOWN:
			if (evt.value == 1) {
				shell_print(sh, "Down button pressed");
			} else {
				shell_print(sh, "Down button released");
			}
			break;
		}
	}

	ret = pm_device_runtime_put(buttons);
	if (ret < 0) {
		shell_error(sh, "Failed to put device (%d)", ret);
		return 0;
	}

	return 0;
}

SHELL_STATIC_SUBCMD_SET_CREATE(sub_buttons_cmds,
			       SHELL_CMD(check, NULL, "Check buttons", cmd_buttons_check),
			       SHELL_SUBCMD_SET_END);

SHELL_SUBCMD_ADD((hwv), buttons, &sub_buttons_cmds, "Buttons", NULL, 0, 0);

int buttons_init(void)
{
	if (!device_is_ready(buttons)) {
		return -ENODEV;
	}

	initialized = true;

	return 0;
}
```

## src/buttons.h
```c
#ifndef APP_SRC_BUTTONS_H_
#define APP_SRC_BUTTONS_H_

#include <stdbool.h>

int buttons_init(void);

extern bool buttons_flag;
#endif /* APP_SRC_BUTTONS_H_ */
```

## src/charger.c
```c
#include <zephyr/drivers/sensor.h>
#include <zephyr/drivers/sensor/npm1300_charger.h>
#include <zephyr/shell/shell.h>

static const struct device *const charger = DEVICE_DT_GET(DT_ALIAS(charger0));
static bool initialized;

static int cmd_charger_status(const struct shell *sh, size_t argc, char **argv)
{
	struct sensor_value volt;
	struct sensor_value current;
	struct sensor_value temp;
	struct sensor_value error;
	struct sensor_value status;
	struct sensor_value vbus_present;

	sensor_sample_fetch(charger);
	sensor_channel_get(charger, SENSOR_CHAN_GAUGE_VOLTAGE, &volt);
	sensor_channel_get(charger, SENSOR_CHAN_GAUGE_AVG_CURRENT, &current);
	sensor_channel_get(charger, SENSOR_CHAN_GAUGE_TEMP, &temp);
	sensor_channel_get(charger, (enum sensor_channel)SENSOR_CHAN_NPM1300_CHARGER_STATUS,
			   &status);
	sensor_channel_get(charger, (enum sensor_channel)SENSOR_CHAN_NPM1300_CHARGER_ERROR, &error);
	sensor_attr_get(charger, (enum sensor_channel)SENSOR_CHAN_NPM1300_CHARGER_VBUS_STATUS,
			(enum sensor_attribute)SENSOR_ATTR_NPM1300_CHARGER_VBUS_PRESENT,
			&vbus_present);

	shell_print(sh, "V: %d.%03d ", volt.val1, volt.val2 / 1000);

	shell_print(sh, "I: %s%d.%04d ", ((current.val1 < 0) || (current.val2 < 0)) ? "-" : "",
		    abs(current.val1), abs(current.val2) / 100);

	shell_print(sh, "T: %s%d.%02d\n", ((temp.val1 < 0) || (temp.val2 < 0)) ? "-" : "",
		    abs(temp.val1), abs(temp.val2) / 10000);

	shell_print(sh, "Charger Status: %d, Error: %d, VBUS: %s\n", status.val1, error.val1,
		    vbus_present.val1 ? "connected" : "disconnected");

	return 0;
}

SHELL_STATIC_SUBCMD_SET_CREATE(sub_charger_cmds, SHELL_CMD(status, NULL, "Get charger status", cmd_charger_status),
			       SHELL_SUBCMD_SET_END);

SHELL_SUBCMD_ADD((hwv), charger, &sub_charger_cmds, "Charger", NULL, 0, 0);

int charger_init(void)
{
	if (!device_is_ready(charger)) {
		return -ENODEV;
	}

	initialized = true;

	return 0;
}
```

## src/charger.h
```c
#ifndef APP_SRC_CHARGER_H_
#define APP_SRC_CHARGER_H_

int charger_init(void);

#endif /* APP_SRC_CHARGER_H_ */
```

## src/display.c
```c
#include <stdlib.h>

#include <zephyr/device.h>
#include <zephyr/devicetree.h>
#include <zephyr/drivers/display.h>
#include <zephyr/shell/shell.h>

#define DISP_WIDTH  DT_PROP(DT_CHOSEN(zephyr_display), width)
#define DISP_HEIGHT DT_PROP(DT_CHOSEN(zephyr_display), height)

static const struct device *const disp = DEVICE_DT_GET(DT_CHOSEN(zephyr_display));
static const struct display_buffer_descriptor desc = {
	.width = DISP_WIDTH,
	.height = DISP_HEIGHT,
	.pitch = DISP_WIDTH + 2 * 8,
};
static bool initialized;

static int cmd_display_on(const struct shell *sh, size_t argc, char **argv)
{
	int err;

	ARG_UNUSED(argc);
	ARG_UNUSED(argv);

	if (!initialized) {
		shell_error(sh, "Display module not initialized");
		return -EPERM;
	}

	err = display_blanking_off(disp);
	if (err < 0) {
		shell_error(sh, "Failed to turn on display (%d)", err);
		return 0;
	}

	shell_print(sh, "Display ON");

	return 0;
}

static int cmd_display_off(const struct shell *sh, size_t argc, char **argv)
{
	int err;

	ARG_UNUSED(argc);
	ARG_UNUSED(argv);

	if (!initialized) {
		shell_error(sh, "Display module not initialized");
		return -EPERM;
	}

	err = display_blanking_on(disp);
	if (err < 0) {
		shell_error(sh, "Failed to turn off display (%d)", err);
		return 0;
	}

	shell_print(sh, "Display OFF");

	return 0;
}

static int cmd_display_vpattern(const struct shell *sh, size_t argc, char **argv)
{
	int err;
	uint8_t *buf;

	ARG_UNUSED(argc);
	ARG_UNUSED(argv);

	if (!initialized) {
		shell_error(sh, "Display module not initialized");
		return -EPERM;
	}

	buf = display_get_framebuffer(disp);

	for (uint16_t i = 0; i < desc.height; i++) {
		memset(&buf[i * desc.pitch / 8], 0xff, desc.width / 8);
	}

	for (uint16_t y = 0U; y <= desc.height; y++) {
		for (uint16_t x = 0U; x <= desc.width; x++) {
			if (x % 4 != 0) {
				buf[y * desc.pitch / 8 + x / 8] &= ~(1 << (x % 8));
			}
		}
	}

	err = display_write(disp, 0, 0, &desc, buf);
	if (err < 0) {
		shell_error(sh, "Failed to write to display (%d)", err);
		return 0;
	}

	shell_print(sh, "Vertical pattern displayed");

	return 0;
}

static int cmd_display_hpattern(const struct shell *sh, size_t argc, char **argv)
{
	int err;
	uint8_t *buf;

	ARG_UNUSED(argc);
	ARG_UNUSED(argv);

	if (!initialized) {
		shell_error(sh, "Display module not initialized");
		return -EPERM;
	}

	buf = display_get_framebuffer(disp);

	for (uint16_t i = 0; i < desc.height; i++) {
		memset(&buf[i * desc.pitch / 8], 0xff, desc.width / 8);
	}

	for (uint16_t y = 0U; y <= desc.height; y++) {
		for (uint16_t x = 0U; x <= desc.width; x++) {
			if (y % 4 != 0) {
				buf[y * desc.pitch / 8 + x / 8] &= ~(1 << (x % 8));
			}
		}
	}

	err = display_write(disp, 0, 0, &desc, buf);
	if (err < 0) {
		shell_error(sh, "Failed to write to display (%d)", err);
		return 0;
	}

	shell_print(sh, "Horizontal pattern displayed");

	return 0;
}

static int cmd_display_brightness(const struct shell *sh, size_t argc, char **argv)
{
	int err;
	uint8_t brightness;

	if (!initialized) {
		shell_error(sh, "Display module not initialized");
		return -EPERM;
	}

	if (argc < 2) {
		shell_error(sh, "Missing brightness value");
		return -EINVAL;
	}

	brightness = strtoul(argv[1], NULL, 0);
	if (brightness > 100) {
		shell_error(sh, "Invalid brightness value");
		return -EINVAL;
	}

	err = display_set_brightness(disp, brightness);
	if (err < 0) {
		shell_error(sh, "Failed to set brightness (%d)", err);
		return 0;
	}

	shell_print(sh, "Brightness set to %d%%", brightness);

	return 0;
}

SHELL_STATIC_SUBCMD_SET_CREATE(
	sub_display_cmds, SHELL_CMD(on, NULL, "Turn on display", cmd_display_on),
	SHELL_CMD(off, NULL, "Turn off display", cmd_display_off),
	SHELL_CMD(vpattern, NULL, "Display vertical pattern", cmd_display_vpattern),
	SHELL_CMD(hpattern, NULL, "Display horizontal pattern", cmd_display_hpattern),
	SHELL_CMD_ARG(brightness, NULL, "Set display brightness", cmd_display_brightness, 2, 0),
	SHELL_SUBCMD_SET_END);

SHELL_SUBCMD_ADD((hwv), display, &sub_display_cmds, "Display", NULL, 0, 0);

int display_init(void)
{
	if (!device_is_ready(disp)) {
		return -ENODEV;
	}

	initialized = true;

	return 0;
}
```

## src/display.h
```c
#ifndef APP_SRC_DISPLAY_H_
#define APP_SRC_DISPLAY_H_

int display_init(void);

#endif /* APP_SRC_DISPLAY_H_ */
```

## src/flash.c
```c
#include <stdlib.h>

#include <zephyr/drivers/flash.h>
#include <zephyr/drivers/regulator.h>
#include <zephyr/kernel.h>
#include <zephyr/pm/device.h>
#include <zephyr/shell/shell.h>

static const struct device *const flash = DEVICE_DT_GET(DT_ALIAS(flash0));
static bool initialized;

static int cmd_flash_id(const struct shell *sh, size_t argc, char **argv)
{
	int ret;
	uint8_t id[3];

	ARG_UNUSED(argc);
	ARG_UNUSED(argv);

	if (!initialized) {
		shell_error(sh, "Flash module not initialized");
		return -EPERM;
	}

	ret = pm_device_action_run(flash, PM_DEVICE_ACTION_RESUME);
	if (ret < 0) {
		shell_error(sh, "Failed to resume flash (%d)", ret);
		return ret;
	}

	ret = flash_read_jedec_id(flash, id);
	if (ret < 0) {
		shell_error(sh, "Failed to read flash ID (%d)", ret);
		goto end;
	}

	shell_print(sh, "Flash ID: %02x %02x %02x", id[0], id[1], id[2]);

end:
	(void)pm_device_action_run(flash, PM_DEVICE_ACTION_SUSPEND);

	return ret;
}

static int cmd_flash_erase(const struct shell *sh, size_t argc, char **argv)
{
	int ret;
	uint32_t addr;
	struct flash_pages_info info;

	if (!initialized) {
		shell_error(sh, "Flash module not initialized");
		return -EPERM;
	}

	if (argc < 2) {
		shell_error(sh, "Missing address or size");
		return -EINVAL;
	}

	addr = strtoul(argv[1], NULL, 0);

	ret = pm_device_action_run(flash, PM_DEVICE_ACTION_RESUME);
	if (ret < 0) {
		shell_error(sh, "Failed to resume flash (%d)", ret);
		return ret;
	}

	ret = flash_get_page_info_by_offs(flash, addr, &info);
	if (ret < 0) {
		shell_error(sh, "Could not determine page size (%d)", ret);
		goto end;
	}

	ret = flash_erase(flash, addr, info.size);
	if (ret < 0) {
		shell_error(sh, "Failed to erase flash (%d)", ret);
		goto end;
	}

	shell_print(sh, "Erased %d bytes at 0x%08x", info.size, addr);

end:
	(void)pm_device_action_run(flash, PM_DEVICE_ACTION_SUSPEND);

	return ret;
}

static int cmd_flash_read(const struct shell *sh, size_t argc, char **argv)
{
	int ret;
	uint32_t addr;
	uint8_t buf[SHELL_HEXDUMP_BYTES_IN_LINE];
	size_t len;

	if (!initialized) {
		shell_error(sh, "Flash module not initialized");
		return -EPERM;
	}

	if (argc < 3) {
		shell_error(sh, "Missing address or length");
		return -EINVAL;
	}

	addr = strtoul(argv[1], NULL, 0);
	len = strtoul(argv[2], NULL, 0);

	ret = pm_device_action_run(flash, PM_DEVICE_ACTION_RESUME);
	if (ret < 0) {
		shell_error(sh, "Failed to resume flash (%d)", ret);
		return ret;
	}

	while (len > 0U) {
		size_t rd = MIN(len, sizeof(buf));

		ret = flash_read(flash, addr, buf, rd);
		if (ret < 0) {
			shell_error(sh, "Failed to read from flash (%d)", ret);
			goto end;
		}

		shell_hexdump_line(sh, addr, buf, rd);

		addr += rd;
		len -= rd;
	}

end:
	(void)pm_device_action_run(flash, PM_DEVICE_ACTION_SUSPEND);

	return ret;
}

static int cmd_flash_write(const struct shell *sh, size_t argc, char **argv)
{
	int ret;
	uint32_t addr;
	uint8_t *buf;
	size_t data_len;

	if (!initialized) {
		shell_error(sh, "Flash module not initialized");
		return -EPERM;
	}

	if (argc < 3) {
		shell_error(sh, "Missing address or data");
		return -EINVAL;
	}

	addr = strtoul(argv[1], NULL, 0);
	data_len = strlen(argv[2]) / 2U;

	buf = k_malloc(data_len);
	if (buf == NULL) {
		shell_error(sh, "Failed to allocate buffer");
		return -ENOMEM;
	}

	for (size_t i = 0U; i < data_len; i++) {
		char hex_byte[3] = { argv[2][i * 2], argv[2][i * 2 + 1], '\0' };
		buf[i] = (uint8_t)strtoul(hex_byte, NULL, 16);
	}

	ret = pm_device_action_run(flash, PM_DEVICE_ACTION_RESUME);
	if (ret < 0) {
		shell_error(sh, "Failed to resume flash (%d)", ret);
		k_free(buf);
		return ret;
	}

	ret = flash_write(flash, addr, buf, data_len);
	if (ret < 0) {
		shell_error(sh, "Failed to write to flash (%d)", ret);
	} else {
		shell_print(sh, "Wrote %d bytes to 0x%08x", data_len, addr);
	}

	k_free(buf);

	(void)pm_device_action_run(flash, PM_DEVICE_ACTION_SUSPEND);

	return ret;
}

SHELL_STATIC_SUBCMD_SET_CREATE(
	sub_flash_cmds, SHELL_CMD(id, NULL, "Read flash ID", cmd_flash_id),
	SHELL_CMD_ARG(erase, NULL, "Erase page: erase PAGE_ADDR", cmd_flash_erase, 2, 0),
	SHELL_CMD_ARG(read, NULL, "Read: read ADDR NUM_BYTES", cmd_flash_read, 3, 0),
	SHELL_CMD_ARG(write, NULL, "Write: write ADDR DATA", cmd_flash_write, 3, 0),
	SHELL_SUBCMD_SET_END);

SHELL_SUBCMD_ADD((hwv), flash, &sub_flash_cmds, "Flash", NULL, 0, 0);

int flash_init(void)
{
	int ret;

	if (!device_is_ready(flash)) {
		return -ENODEV;
	}

	ret = pm_device_action_run(flash, PM_DEVICE_ACTION_SUSPEND);
	if (ret < 0) {
		return ret;
	}

	initialized = true;

	return 0;
}
```

## src/haptic.c
```c
#include <stdlib.h>

#include <zephyr/shell/shell.h>

#include <hwv/drivers/haptic.h>

static const struct device *const haptic = DEVICE_DT_GET(DT_ALIAS(haptic0));
static bool initialized;

static int cmd_haptic_configure(const struct shell *sh, size_t argc, char **argv)
{
	int err;
	uint8_t ampl;

	if (!initialized) {
		shell_error(sh, "Haptic module not initialized");
		return -EPERM;
	}

	if (argc < 2) {
		shell_error(sh, "Missing amplitude");
		return -EINVAL;
	}

	ampl = strtoul(argv[1], NULL, 0);
	if (ampl > 100U) {
		shell_error(sh, "Amplitude must be less than or equal to 100");
		return -EINVAL;
	}

	err = haptic_configure(haptic, ampl);
	if (err < 0) {
		shell_error(sh, "Failed to configure haptic (%d)", err);
		return err;
	}

	shell_print(sh, "Haptic configured");

	return 0;
}

SHELL_STATIC_SUBCMD_SET_CREATE(sub_haptic_cmds,
			       SHELL_CMD_ARG(configure, NULL, "Configure haptic",
					     cmd_haptic_configure, 2, 0),
			       SHELL_SUBCMD_SET_END);

SHELL_SUBCMD_ADD((hwv), haptic, &sub_haptic_cmds, "Haptic", NULL, 0, 0);

int haptic_init(void)
{
	if (!device_is_ready(haptic)) {
		return -ENODEV;
	}

	initialized = true;

	return 0;
}
```

## src/haptic.h
```c
#ifndef APP_SRC_HAPTIC_H_
#define APP_SRC_HAPTIC_H_

int haptic_init(void);

#endif /* APP_SRC_HAPTIC_H_ */
```
