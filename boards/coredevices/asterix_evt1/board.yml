## boards/pebble/asterix_evt1/Kconfig.defconfig
```kconfig
if BOARD_ASTERIX_EVT1

config BT_CTLR
	default y if BT

endif # BOARD_ASTERIX_EVT1
```

## boards/pebble/pebble_evb/Kconfig
```kconfig
if SOC_NRF5340_CPUAPP_QKAA

config DOMAIN_CPUNET_BOARD
	string
	default "pebble_evb/nrf5340/cpunet" if BOARD_PEBBLE_EVB_NRF5340_CPUAPP

endif # SOC_NRF5340_CPUAPP_QKAA

config DOMAIN_CPUAPP_BOARD
	string
	default "pebble_evb/nrf5340/cpuapp" if BOARD_PEBBLE_EVB_NRF5340_CPUNET
```

## boards/pebble/pebble_evb/Kconfig.pebble_evb
```kconfig
config BOARD_PEBBLE_EVB
	select SOC_NRF5340_CPUAPP_QKAA if BOARD_PEBBLE_EVB_NRF5340_CPUAPP
	select SOC_NRF5340_CPUNET_QKAA if BOARD_PEBBLE_EVB_NRF5340_CPUNET
```

## drivers/Kconfig
```kconfig
menu "Drivers"
rsource "led/Kconfig"
rsource "display/Kconfig"
rsource "input/Kconfig"
rsource "haptic/Kconfig"
endmenu
```

## drivers/display/Kconfig
```kconfig
menuconfig DISPLAY_EXTERNAL
	bool "Display drivers (external)"
	default y if DISPLAY

if DISPLAY_EXTERNAL

rsource "Kconfig.ls013b7dh05"

endif # DISPLAY_EXTERNAL
```

## drivers/display/Kconfig.ls013b7dh05
```kconfig
config DISPLAY_LS013B7DH05
	bool "Sharp LS013B7DH05 display"
	depends on DT_HAS_SHARP_LS013B7DH05_ENABLED
	select SPI
	select GPIO
	select LED
	select PWM
	default y
	help
	  Driver for the Sharp LS013B7DH05 display
```

## drivers/haptic/Kconfig
```kconfig
menuconfig HAPTIC
	bool "Haptic drivers"

if HAPTIC

config HAPTIC_INIT_PRIORITY
	int "Haptic device drivers init priority"
	default 90
	help
	  Haptic device drivers init priority.

module = HAPTIC
module-str = haptic
source "subsys/logging/Kconfig.template.log_config"

rsource "Kconfig.drv2604"

endif # HAPTIC
```

## drivers/haptic/Kconfig.drv2604
```kconfig
config HAPTIC_DRV2604
	bool "TI DRV2604 haptic controller"
	depends on DT_HAS_TI_DRV2604_ENABLED
	select GPIO
	select I2C
	default y
	help
	  Driver for the TI DRV2604 haptic controller
```

## drivers/input/Kconfig
```kconfig
menuconfig INPUT_EXTERNAL
	bool "Input drivers (external)"
	default y if INPUT

if INPUT_EXTERNAL

rsource "Kconfig.lsm6dso_tap"

endif # INPUT_EXTERNAL
```

## drivers/input/Kconfig.lsm6dso_tap
```kconfig
config INPUT_LSM6DSO_TAP
	bool "LSM6DSO (TAP depection) driver"
	default y
	depends on DT_HAS_ST_LSM6DSO_TAP_ENABLED
	depends on ZEPHYR_HAL_ST_MODULE
	select I2C
	select GPIO
	select HAS_STMEMSC
	select USE_STDC_LSM6DSO
	help
	  Enable driver for LSM6DSO (tap detection driver)

if INPUT_LSM6DSO_TAP
# TODO: fix hal_st glue code location upstream
source "drivers/sensor/st/stmemsc/Kconfig"
endif
```

## drivers/led/Kconfig
```kconfig
menuconfig LED_EXTERNAL
	bool "LED drivers (external)"
	default y if LED

if LED_EXTERNAL

rsource "Kconfig.lm3508"

endif # LED_EXTERNAL
```

## drivers/led/Kconfig.lm3508
```kconfig
config LED_LM3508
	bool "TI LM3508 LED controller"
	depends on DT_HAS_TI_LM3508_ENABLED
	select GPIO
	select PWM
	default y
	help
	  Driver for the TI LM3508 LED controller

config LED_LM3508_INIT_PRIORITY
	int "LM3508 Initialization priority"
	default 80
	depends on LED_LM3508
	help
	  Initialization priority for the LM3508 driver
```

## drivers/sensor/Kconfig
```kconfig
menuconfig SENSOR_EXTERNAL
	bool "Sensor drivers (external)"
	default y if SENSOR

if SENSOR_EXTERNAL

rsource "bosch/Kconfig"

endif # SENSOR_EXTERNAL
```

## drivers/sensor/bmm350/Kconfig
```kconfig
config SENSOR_BMM350
	bool "Bosch BMM350 3-axis magnetic sensor"
	default y
	depends on DT_HAS_BOSCH_BMM350_ENABLED
	select I2C
	help
	  Enables Bosch BMM350 3-axis magnetic sensor driver.
```

## dts/bindings/audio/renesas,da7212.yaml
```yaml
description: Renesas DA7212 Audio Coded

compatible: "renesas,da7212"

include: i2c-device.yaml
```

## dts/bindings/display/sharp,ls013b7dh05.yaml
```yaml
description: Sharp LS013B7DH05 LCD Module

compatible: "sharp,ls013b7dh05"

include: ["display-controller.yaml", "spi-device.yaml"]

properties:
  disp-gpios:
    type: phandle-array
    description: Display ON/OFF GPIO

  extcomin-gpios:
    type: phandle-array
    description: Display EXTCOMIN GPIO

  backlight:
    type: phandle
    description: Backlight controller
```

## dts/bindings/input/st,lsm6dso-tap.yaml
```yaml
description: LSM6DSO 6-axis IMU sensor (TAP detection)

compatible: "st,lsm6dso-tap"

include: ["i2c-device.yaml", "sensor-device.yaml"]

properties:
  int1-gpios:
    type: phandle-array
    required: true
    description: INT1 GPIO
```

## dts/bindings/input/ti,drv2604.yaml
```yaml
description: TI DRV2604 Haptic Driver for ERM and LRA

compatible: "ti,drv2604"

include: base.yaml

properties:
  en-gpios:
    type: phandle-array
    description: Enable GPIO
```

## dts/bindings/led/ti,lm3508.yaml
```yaml
description: TI LM3508 LED driver

compatible: "ti,lm3508"

include: base.yaml

properties:
  en-gpios:
    type: phandle-array
    description: Enable GPIO

  pwms:
    type: phandle-array
    required: true
    description: PWM channel for the LED driver
```

## dts/bindings/sensor/analog-light-sensor.yaml
```yaml
description: Analog light sensor

compatible: "analog-light-sensor"

include: base.yaml

properties:
  io-channels:
    required: true
    type: phandle-array
    description: |
      ADC specifier for light sensor output.
```
