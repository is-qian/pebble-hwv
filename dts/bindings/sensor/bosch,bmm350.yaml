## dts/bindings/sensor/bosch,bmm350.yaml
```yaml
description: Bosch BMM350 Geomagnetic sensor

compatible: "bosch,bmm350"

include: ["sensor-device.yaml", "i2c-device.yaml"]

properties:
  int-gpios:
    type: phandle-array
    description: |
      Interrupt output pin
```

## dts/bindings/sensor/bosch,bmp390.yaml
```yaml
description: Bosch BMP390 pressure sensor

compatible: "bosch,bmp390"

include: ["sensor-device.yaml", "spi-device.yaml"]

properties:
  int-gpios:
    type: phandle-array
    description: |
      Interrupt output pin
```

## subsys/bluetooth/Kconfig
```kconfig
menu "Bluetooth Low Energy"

if BT
comment "BLE Libraries"
rsource "services/Kconfig"
endif # BT

endmenu
```

## subsys/bluetooth/services/Kconfig
```kconfig
menu "Bluetooth Services"

config BT_CUSTOM_SERVICES
	bool

rsource "Kconfig.lbs"

endmenu
```

## west.yml
```yaml
manifest:
  remotes:
    - name: zephyrproject-rtos
      url-base: https://github.com/zephyrproject-rtos

  projects:
    - name: zephyr
      remote: zephyrproject-rtos
      revision: v4.1.0 
      import:
        name-allowlist:
          - cmsis
          - hal_nordic
          - hal_st
          - segger
          - mbedtls
          - zephyr
```
